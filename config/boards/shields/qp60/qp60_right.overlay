/*
 * Copyright (c) 2020 The ZMK Contributors
 *
 * SPDX-License-Identifier: MIT
 */

#include "qp60.dtsi"

&default_transform {
	col-offset = <6>;
};

&kscan0 {
	col-gpios
		= <&pro_micro_d 10 GPIO_ACTIVE_HIGH>
		, <&pro_micro_d 16 GPIO_ACTIVE_HIGH>
		, <&pro_micro_d 1 GPIO_ACTIVE_HIGH>
		, <&pro_micro_d 0 GPIO_ACTIVE_HIGH>
		, <&pro_micro_a 15 GPIO_ACTIVE_HIGH>
		, <&pro_micro_a 14 GPIO_ACTIVE_HIGH>
		;
};

