/*
 * Copyright (c) 2020 The ZMK Contributors
 *
 * SPDX-License-Identifier: MIT
 */

#include "qp60.dtsi"

&kscan0 {
	col-gpios
		= <&pro_micro_a 19 GPIO_ACTIVE_HIGH>
		, <&pro_micro_a 18 GPIO_ACTIVE_HIGH>
		, <&pro_micro_d 15 GPIO_ACTIVE_HIGH>
		, <&pro_micro_d 14 GPIO_ACTIVE_HIGH>
		, <&pro_micro_d 16 GPIO_ACTIVE_HIGH>
		, <&pro_micro_d 10 GPIO_ACTIVE_HIGH>
		;
};

&left_encoder {
	status = "okay";
};
