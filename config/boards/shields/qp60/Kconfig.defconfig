## config/boards/shields/qp60/Kconfig.defconfig
```kconfig
# Copyright (c) 2020 The ZMK Contributors
# SPDX-License-Identifier: MIT

if SHIELD_QP60_LEFT

config ZMK_KEYBOARD_NAME
	default "qp60 Left"

config ZMK_SPLIT_BLE_ROLE_CENTRAL
	default y
	
endif

if SHIELD_QP60_RIGHT

config ZMK_KEYBOARD_NAME
	default "qp60 Right"

endif

if SHIELD_QP60_LEFT || SHIELD_QP60_RIGHT

config ZMK_SPLIT
	default y

endif
```

## config/boards/shields/qp60/Kconfig.shield
```kconfig
# Copyright (c) 2020 The ZMK Contributors
# SPDX-License-Identifier: MIT

config SHIELD_QP60_LEFT
	def_bool $(shields_list_contains,qp60_left)

config SHIELD_QP60_RIGHT
	def_bool $(shields_list_contains,qp60_right)
```

## config/west.yml
```yaml
manifest:
  remotes:
    - name: zmkfirmware
      url-base: https://github.com/zmkfirmware
    - name: anodynous
      url-base: https://github.com/anodynous
  projects:
    - name: zmk
      remote: anodynous
      revision: updated_mouse-pr_split-encoder
      import: app/west.yml
  self:
    path: config  
```
